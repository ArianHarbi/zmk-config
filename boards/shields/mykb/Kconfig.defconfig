## boards/shields/mykb/Kconfig.defconfig
```kconfig
if SHIELD_MYKB_LEFT

config ZMK_KEYBOARD_NAME
    default "myKB"

config ZMK_SPLIT_ROLE_CENTRAL
    default y

endif # SHIELD_MYKB_LEFT

if SHIELD_MYKB_LEFT || SHIELD_MYKB_RIGHT

config ZMK_SPLIT
    default y

endif # SHIELD_MYKB_LEFT || SHIELD_MYKB_RIGHT
```

## boards/shields/mykb/Kconfig.shield
```kconfig
config SHIELD_MYKB_LEFT
    def_bool $(shields_list_contains,mykb_left)

config SHIELD_MYKB_RIGHT
    def_bool $(shields_list_contains,mykb_right)
```
